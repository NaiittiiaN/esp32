## firmware/esp32-idf-matter-sensors/sdkconfig.defaults
```kconfig
CONFIG_PARTITION_TABLE_CUSTOM=y
CONFIG_PARTITION_TABLE_CUSTOM_FILENAME="partitions.csv"
CONFIG_PARTITION_TABLE_FILENAME="partitions.csv"
CONFIG_PARTITION_TABLE_OFFSET=0x8000
CONFIG_ESPTOOLPY_FLASHSIZE_4MB=y
CONFIG_COMPILER_CXX_EXCEPTIONS=y
CONFIG_COMPILER_CXX_RTTI=y
CONFIG_LOG_DEFAULT_LEVEL_INFO=y
CONFIG_LWIP_LOCAL_HOSTNAME="esp32-matter-sensors"
CONFIG_ESP_HTTP_SERVER_ENABLE=y
CONFIG_MDNS_MAX_SERVICES=8
```
